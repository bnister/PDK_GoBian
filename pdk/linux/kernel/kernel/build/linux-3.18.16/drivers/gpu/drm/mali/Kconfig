## pdk/linux/kernel/kernel/build/linux-3.18.16/drivers/gpu/drm/mali/Kconfig
```kconfig
config DRM_MALI
	tristate "DRM Support for Mali-400"
	depends on DRM && UMP
	help
	  Choose this option if you have a GoWarrior TigerBoard.
	  If M is selected the module will be called gowarriordrm.
```
